## meta-evb/meta-common/conf/layer.conf
```bitbake
BBPATH .= ":${LAYERDIR}"

BBFILE_COLLECTIONS += "evb_common"
BBFILE_PATTERN_evb_common = "^${LAYERDIR}/"
BBFILE_PATTERN_IGNORE_EMPTY_evb_common = "1"
BBFILES += "${LAYERDIR}/recipes-*/*/*.bb ${LAYERDIR}/recipes-*/*/*.bbappend"

# Limit EVB camera builds to the reduced phosphor recipe set without modifying meta-phosphor.
BBMASK:append = " \
	.*/meta-phosphor/recipes-phosphor/bios/biosconfig-manager_git\\.bb|\
	.*/meta-phosphor/recipes-phosphor/console/obmc-console_git\\.bb|\
	.*/meta-phosphor/recipes-phosphor/inventory/phosphor-inventory-manager-assettag\\.bb|\
	.*/meta-phosphor/recipes-phosphor/inventory/phosphor-inventory-manager_git\\.bb|\
	.*/meta-phosphor/recipes-phosphor/libcper/libcper_git\\.bb|\
	.*/meta-phosphor/recipes-phosphor/libmctp/libmctp_git\\.bb|\
	.*/meta-phosphor/recipes-phosphor/libpldm/libpldm_git\\.bb|\
	.*/meta-phosphor/recipes-phosphor/pldm/pldm_git\\.bb|\
	.*/meta-phosphor/recipes-phosphor/smbios/smbios-mdr_git\\.bb \
"

LAYERSERIES_COMPAT_evb_common = "whinlatter walnascar"
```

## meta-evb/meta-common/conf/machine/include/evb-rpi-camera-common.inc
```bitbake
IMAGE_INSTALL:append = " go2rtc dbus-ip-camera"

PREFERRED_VERSION_libgpiod = "2.2.2"

# Keep a minimal local syslog provider without rsyslog.
VIRTUAL-RUNTIME_syslog = "busybox-syslog"
```

## meta-evb/meta-evb-raspberry4b/conf/layer.conf
```bitbake
BBPATH .= ":${LAYERDIR}"
BBFILES += "${LAYERDIR}/recipes-*/*/*.bb ${LAYERDIR}/recipes-*/*/*.bbappend"

BBFILE_COLLECTIONS += "evb_raspberry4b"
BBFILE_PATTERN_evb_raspberry4b = "^${LAYERDIR}/"
BBFILE_PATTERN_IGNORE_EMPTY_evb_raspberry4b = "1"

LAYERSERIES_COMPAT_evb_raspberry4b = "whinlatter walnascar"
```

## meta-evb/meta-evb-raspberry4b/conf/machine/evb-rpi4-64.conf
```bitbake
#@TYPE: Machine
#@NAME: EVB RaspberryPi 4B (64bit)
#@DESCRIPTION: OpenBMC EVB machine configuration for RaspberryPi 4 Model B in 64-bit mode

require conf/machine/raspberrypi4-64.conf

# Limit the EVB machine to the Raspberry Pi 4 Model B device tree.
RPI_KERNEL_DEVICETREE = "broadcom/bcm2711-rpi-4-b.dtb"

# RPi4 kernel deploy does not produce fitImage; use linux.bin for MMC tar image assembly.
FLASH_KERNEL_IMAGE = "linux.bin"

include conf/machine/include/obmc-evb-common.inc
include conf/machine/include/evb-rpi-camera-common.inc
```

## meta-evb/meta-evb-raspberry5b/conf/machine/evb-rpi5-64.conf
```bitbake
#@TYPE: Machine
#@NAME: EVB RaspberryPi 5B (64bit)
#@DESCRIPTION: OpenBMC EVB machine configuration for RaspberryPi 5 Model B in 64-bit mode

MACHINEOVERRIDES =. "raspberrypi5:"

require conf/machine/raspberrypi5.conf

# Use OpenBMC MMC image/profile for SD card boot media.
require conf/distro/include/phosphor-mmc.inc

# Limit the EVB machine to the Raspberry Pi 5 Model B device tree.
RPI_KERNEL_DEVICETREE = "broadcom/bcm2712-rpi-5-b.dtb"

# RPi5 kernel deploy does not produce fitImage; use linux.bin for MMC tar image assembly.
FLASH_KERNEL_IMAGE = "linux.bin"

include conf/machine/include/obmc-evb-common.inc
include conf/machine/include/evb-rpi-camera-common.inc
```

## meta-evb/meta-evb-rockchip/conf/layer.conf
```bitbake
# We have a conf and classes directory, add to BBPATH
BBPATH .= ":${LAYERDIR}"

BBFILE_COLLECTIONS += "evb-rockchip"
BBFILE_PATTERN_evb-rockchip = ""
BBFILE_PATTERN_IGNORE_EMPTY_evb-rockchip = "1"
LAYERSERIES_COMPAT_evb-rockchip = "whinlatter walnascar"
```

## meta-evb/meta-evb-rockchip/meta-evb-ok3568-c/conf/layer.conf
```bitbake
BBPATH .= ":${LAYERDIR}"

BBFILES += "${LAYERDIR}/recipes-*/*/*.bbappend"

BBFILE_COLLECTIONS += "evb_ok3568c"
BBFILE_PATTERN_evb_ok3568c = "^${LAYERDIR}/"
BBFILE_PATTERN_IGNORE_EMPTY_evb_ok3568c = "1"

LAYERSERIES_COMPAT_evb_ok3568c = "whinlatter walnascar"
```

## meta-evb/meta-evb-rockchip/meta-evb-ok3568-c/conf/machine/evb-ok3568-c-64.conf
```bitbake
#@TYPE: Machine
#@NAME: EVB OK3568-C (64bit)
#@DESCRIPTION: OpenBMC EVB machine configuration for Forlinx OK3568-C in 64-bit mode

MACHINEOVERRIDES =. "ok3568c:rk3568:"

require conf/machine/rockchip-rk3568-evb.conf

# Use OpenBMC MMC image/profile for SD card or eMMC boot media.
require conf/distro/include/phosphor-mmc.inc
require conf/machine/include/obmc-bsp-common.inc

# First-stage bring-up reuses the RK3568 EVB device tree on the Rockchip 6.1 baseline.
# Replace this with an OK3568-C-specific DTB once the 6.1 board DTS is landed.
KERNEL_DEVICETREE = "rockchip/rk3568-ok3568-c.dtb"

# First-stage U-Boot keeps the known-good RK3568 EVB defconfig.
UBOOT_MACHINE = "rk3568_defconfig"
RK_UBOOT_CFG = "rk3568"

include conf/machine/include/obmc-evb-common.inc
```

## meta-evb/meta-evb-rockchip/meta-evb-rock3a/conf/layer.conf
```bitbake
BBPATH .= ":${LAYERDIR}"

BBFILES += "${LAYERDIR}/recipes-*/*/*.bbappend"

BBFILE_COLLECTIONS += "evb_rock3a"
BBFILE_PATTERN_evb_rock3a = "^${LAYERDIR}/"
BBFILE_PATTERN_IGNORE_EMPTY_evb_rock3a = "1"

LAYERSERIES_COMPAT_evb_rock3a = "whinlatter walnascar"
```

## meta-evb/meta-evb-rockchip/meta-evb-rock3a/conf/machine/evb-rock3a-64.conf
```bitbake
#@TYPE: Machine
#@NAME: EVB Rock3A (64bit)
#@DESCRIPTION: OpenBMC EVB machine configuration for Radxa Rock3A in 64-bit mode

MACHINEOVERRIDES =. "rock3a:rk3568:"

require conf/machine/rockchip-rk3568-evb.conf

# Use OpenBMC MMC image/profile for SD card or eMMC boot media.
require conf/distro/include/phosphor-mmc.inc

# Rock3A device tree on RK3568.
KERNEL_DEVICETREE = "rockchip/rk3568-rock-3a.dtb"

include conf/machine/include/obmc-evb-common.inc
```
